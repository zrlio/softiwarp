## hw/softiwarp/Kconfig
```kconfig
config INFINIBAND_SOFTIWARP
	tristate "Software iWARP Stack (EXPERIMENTAL)"
	depends on INET && EXPERIMENTAL
	---help---
	  Kernel Software Implementation of the iWARP protocol stack

	  This driver implements the iWARP protocol stack in software
	  and interfaces with in-kernel TCP/IP as well as the OFED
	  verbs interfaces.

	  Please send feedback to <bmt@zurich.ibm.com>.

	  To compile this driver as a module, choose M here: the module
	  will be called siw.
```
